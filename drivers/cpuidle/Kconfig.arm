## drivers/cpuidle/Kconfig.arm
```kconfig
#
# ARM CPU Idle drivers
#

config ARM_BIG_LITTLE_CPUIDLE
	bool "Support for ARM big.LITTLE processors"
	depends on ARCH_VEXPRESS_TC2_PM
	select ARM_CPU_SUSPEND
	select CPU_IDLE_MULTIPLE_DRIVERS
	help
	  Select this option to enable CPU idle driver for big.LITTLE based
	  ARM systems. Driver manages CPUs coordination through MCPM and
	  define different C-states for little and big cores through the
	  multiple CPU idle drivers infrastructure.

config ARM_SUNXI_CPUIDLE
	bool "CPU Idle Driver for SUNXI"
	depends on ARCH_SUNXI && EVB_PLATFORM
	default y
	help
	  Select this to enable cpuidle on sunxi platform.
```

## drivers/gpu/ion/Kconfig
```kconfig
menuconfig ION
	tristate "Ion Memory Manager"
	select GENERIC_ALLOCATOR
	select DMA_SHARED_BUFFER
	help
	  Chose this option to enable the ION Memory Manager.

config ION_TEGRA
	tristate "Ion for Tegra"
	depends on ARCH_TEGRA && ION
	help
	  Choose this option if you wish to use ion on an nVidia Tegra.

config ION_SUNXI
	bool "ion for sunxi"
	depends on ARCH_SUNXI && ION
	help
	  ION for sunxi platforms.

config ION_SUNXI_CARVEOUT_SIZE
	int "memory size(in MB) for sunxi carveout ion heap."
	default 128
	depends on ION_SUNXI
	help
	  Select memory size for sunxi carveout ion heap, the memory is used by modules that need physical continous memory, such as gpu and ve...
	  Examples:
		100 => reserve 100M bytes memory for carveout heap.
		230 => reserve 230M bytes memory for carveout heap.
```

## drivers/media/video/sunxi-vfe/Kconfig
```kconfig
config CSI_VFE
	tristate "v4l2 driver for SUNXI"
	default m
	select VIDEOBUF_DMA_CONTIG
	
```

## drivers/misc/rf_pm/Kconfig
```kconfig
#
# Allwinner rf module pm driver.
#
config AW_RF_PM
  bool "Allwinner rf module pm driver"
  depends on WIRELESS || RFKILL
  help
    allwinner rf module pm driver
```

## drivers/net/wireless/bcmdhd/Kconfig
```kconfig
config BCMDHD
	tristate "Broadcom 4329/30 wireless cards support"
	depends on MMC
	default n
	---help---
	  This module adds support for wireless adapters based on
	  Broadcom 4329/30 chipset.

config BCMDHD_FW_PATH
	depends on BCMDHD
	bool "Use customized firmware path"
	default y
	---help---
	  Use customized firmware path.

config BCMDHD_NVRAM_PATH
	depends on BCMDHD
	bool "Use customized NVRAM path"
	default y
	---help---
	  Use customized NVRAM path.

config BCMDHD_CONFIG_PATH
	depends on BCMDHD
	bool "Use customized config path"
	default y
	---help---
	  Use customized config path.

config BCMDHD_WEXT
	bool "Enable WEXT support"
	depends on BCMDHD && CFG80211 = n
	select WIRELESS_EXT
	select WEXT_PRIV
	help
	  Enables WEXT support

choice
    depends on BCMDHD
    prompt "Interrupt type"
config BCMDHD_OOB
	depends on BCMDHD
	bool "Out-of-Band Interrupt"
	---help---
		Interrupt from WL_HOST_WAKE.
config BCMDHD_SDIO_IRQ
	depends on  BCMDHD
	bool "In-Band Interrupt"
	---help---
		Interrupt from SDIO DAT[1]
endchoice
```

## drivers/net/wireless/rtl8189es/Kconfig
```kconfig
config RTL8189ES
	tristate "Realtek 8189E SDIO WiFi"
	select WIRELESS_EXT
	select WEXT_PRIV
	---help---
	  Help message of RTL8189ES
```

## drivers/net/wireless/rtl8723bs/Kconfig
```kconfig
config RTL8723BS
	tristate "Realtek 8723B SDIO WiFi"
	---help---
	  Help message of RTL8723BS
```

## drivers/usb/sunxi_usb/Kconfig
```kconfig
#---------------------------------------------
#- softwinner SUNXI USB300 Dual Role Controller Driver.
#---------------------------------------------
source "drivers/usb/sunxi_usb/usb3/Kconfig"


#---------------------------------------------
#- softwinner SUNXI USB200 Dual Role Controller Driver.
#---------------------------------------------
source "drivers/usb/sunxi_usb/udc/Kconfig"


#---------------------------------------------
#- config USB Dual Role Manager.
#---------------------------------------------
source "drivers/usb/sunxi_usb/manager/Kconfig"
```

## drivers/usb/sunxi_usb/hcd/Kconfig
```kconfig
config USB_SUNXI_HCD0
	tristate "SUNXI USB2.0 OTG Host Controller"
	depends on USB_SUNXI_HCD && USB_SUNXI_USB0_OTG && !(ARCH_SUN9IW1)
	help
	    SoftWinner SUNXI USB2.0 Host Controller0.
```

## drivers/usb/sunxi_usb/manager/Kconfig
```kconfig
menuconfig USB_SUNXI_USB
    tristate "SUNXI USB Dual Role Manager"
    depends on ARCH_SUNXI
    help
        SUNXI USB Dual Role Manager

config USB_SUNXI_USB_MANAGER
    tristate "SUNXI USB Manager"
    depends on USB_SUNXI_USB
    help
        manager all usb controller.

#---------------------------------------------
#-
#- usb0 mode slecet.
#-
#---------------------------------------------
choice

    prompt "USB0 Controller support"
    depends on (USB_SUNXI_USB && USB_SUNXI_USB_MANAGER)
    help
        usb0 Controller mode slecet. choice "device only", then usb0 can only use for device.
        choice "host only", then usb0 can only use for host. choice "OTG", then usb0 can only
        use device and host.

config USB_SUNXI_USB0_OTG
    boolean "otg support"
    help
        usb0 can only use for device and host.

endchoice
```

## drivers/usb/sunxi_usb/udc/Kconfig
```kconfig
config USB_SUNXI_UDC0
	boolean "SUNXI USB2.0 Peripheral Controller"
	depends on USB_SUNXI_USB_MANAGER && USB_SUNXI_USB0_OTG && !(ARCH_SUN9IW1)
	select USB_GADGET_DUALSPEED
	select USB_GADGET_SELECTED
	help
	   USB device only

if USB_SUNXI_UDC0

config USB_SUNXI_USB_DEBUG
    bool "SUNXI USB driver debug message"
    depends on USB_SUNXI_USB
    help
        SUNXI USB driver debug message.

config UDC_HIGH_BANDWITH_ISO
	bool "SUNXI UDC HIGH BANDWITH ISO"
  depends on USB_SUNXI_USB && ARCH_SUN8IW6
  help
       udc support high bandwidth iso .
endif
```

## drivers/usb/sunxi_usb/usb3/Kconfig
```kconfig
config SUNXI_USB300
	tristate "SUNXI USB3 DRD Core Support"
	depends on (USB && USB_GADGET) && ARCH_SUN9IW1
	select USB_OTG_UTILS
	select USB_GADGET_DUALSPEED
	select USB_GADGET_SUPERSPEED
	select USB_XHCI_PLATFORM
	help
	  Say Y or M here if your system has a Dual Role SuperSpeed
	  USB controller based on the DesignWare USB3 IP Core.

	  If you choose to build this driver is a dynamically linked
	  module, the module will be called sunxi.ko.

if SUNXI_USB300

config USB_XHCI_ENHANCE
    bool "Enhance for xhci controlle"
    depends on ARCH_SUN9IW1
	help
	  Say Y here to susport special usb3 udev on SUNXI Driver.

config SUNXI_USB300_DEBUG
	bool "Enable Debugging Messages"
	help
	  Say Y here to enable debugging messages on SUNXI Driver.

config SUNXI_USB300_VERBOSE
	bool "Enable Verbose Debugging Messages"
	depends on SUNXI_USB300_DEBUG
	help
	  Say Y here to enable verbose debugging messages on SUNXI Driver.

endif
```

## drivers/video/sunxi/Kconfig
```kconfig
#
# Video configuration for sunxi platform
#

menu "Video support for sunxi"
	depends on FB

config DISP2_SUNXI
  tristate "DISP Driver Support(sunxi-disp2)"
  depends on (ARCH_SUN8IW6 || ARCH_SUN8IW7 || ARCH_SUN8IW8 || ARCH_SUN8IW9)
  default n
  ---help---

config HDMI_DISP2_SUNXI
  tristate "HDMI Driver Support(sunxi-disp2)"
  depends on ((ARCH_SUN8IW6 || ARCH_SUN8IW7) && DISP2_SUNXI)
  default n
  ---help---

config TV_DISP2_SUNXI
  tristate "TV Driver Support(sunxi-disp2)"
  depends on ((ARCH_SUN8IW7) && DISP2_SUNXI)
  default n
  ---help---

config TV_AC200
  tristate "AC200 TV module Support(sunxi-disp2)"
  depends on ((ARCH_SUN8IW6) && DISP2_SUNXI && MFD_AC200)
  default n
  ---help---

config DISP2_SUNXI_BOOT_COLORBAR
  bool "boot colorbar for disp driver(sunxi-disp2)"
  depends on (ARCH_SUN8IW7 && DISP2_SUNXI)
  default n
  ---help---

config DISP2_SUNXI_DEBUG
  bool "debugfs for disp driver(sunxi-disp2)"
  depends on DISP2_SUNXI
  default n
  ---help---

endmenu
```

## sound/soc/sunxi/daudio0/Kconfig
```kconfig
config SND_SUNXI_SOC_DAUDIO0_INTERFACE
	tristate "SoC daudio0 tdm interface for SUNXI chips"
	depends on ARCH_SUN9IW1 || ARCH_SUN8IW6|| ARCH_SUN8IW7 || ARCH_SUN8IW8
	select SND_SOC_DMAENGINE_PCM
	default n
	help
	  Say Y or M if you want to add support for codecs attached to
	  the SUNXI DAUDIO TDM interface. You will also need
	  to select the audio interfaces to support below.

config SND_SUNXI_SOC_DAUDIO0_PUBLIC_MACHINE
	tristate "Public Machine for SUNXI chips"
	depends on (ARCH_SUN9IW1 || ARCH_SUN8IW6|| ARCH_SUN8IW7 || ARCH_SUN8IW8) && MFD_AC200=n
	default n
	help
	  Say Y or M if you want to add sun8iw1 audiocodec support
	 
config SND_SUNXI_SOC_SUN8IW6_AC100
	tristate "Machine for A83 AC100"
	depends on ARCH_SUN8IW6 && MFD_AC100 && SND_SOC_AC100DAPM_CODEC
	default n
	help
	  Say Y or M if you want to add sun8iw6 codec support

config SND_SUNXI_SOC_SUN8IW6_AC200
	tristate "Machine for A83 AC200"
	depends on ARCH_SUN8IW6 && MFD_AC200
	help
	  Say Y or M if you want to add sun8iw6 codec support

config SND_VIRBB_DAI
	tristate "virtual bb interface"
	depends on ARCH_SUN8IW6 && MFD_AC100=y
	default n
	help
	  Say Y or M if you want to add sun8iw1 audiocodec support
```

## sound/soc/sunxi/daudio1/Kconfig
```kconfig
config SND_SUNXI_SOC_DAUDIO1_INTERFACE
	tristate "SoC daudio1 tdm interface for SUNXI chips"
	depends on ARCH_SUN8IW7
	select SND_SOC_DMAENGINE_PCM
	default n
	help
	  Say Y or M if you want to add support for codecs attached to
	  the SUNXI DAUDIO TDM interface. You will also need
	  to select the audio interfaces to support below.
```

## sound/soc/sunxi/virtual_audio/Kconfig
```kconfig
config SND_SUNXI_SOC_VIRTUAL_AUDIO_INTERFACE
	tristate 
	#"SoC virtual audio interface for the ReuuiMlla SUNXI chips"
	default n
	help
	  Say Y or M if you want to add support for codecs attached to
	  the SUNXI VIRTUAL AUDIO interface. You will also need
	  to select the audio interfaces to support below.
```
